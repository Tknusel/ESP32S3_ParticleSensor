/*
  Particle Sensor Display
  
  This sketch integrates a BMV080 particulate matter sensor with an OLED display
  to show real-time air quality measurements.
  
  Hardware Connections:
  - ESP32-S3 connected to BMV080 via I2C/QWIIC
  - ESP32-S3 connected to OLED display via I2C
  
  Features:
  - Displays integer values for PM1, PM2.5, and PM10
  - Changes display based on pollution level
  - Blinking wind icon in high pollution state
  - Warning display when sensor is obstructed
  
  Libraries required:
  - SparkFun_BMV080_Arduino_Library
  - U8g2lib
  - Wire
  - USB and USBCDC (for ESP32-S3)
*/

#include "SparkFun_BMV080_Arduino_Library.h" // http://librarymanager/All#SparkFun_BMV080
#include <U8g2lib.h>
#include <Wire.h>
#include <USB.h>
#include <USBCDC.h>

USBCDC USBSerial;
SparkFunBMV080 bmv080; // Create an instance of the BMV080 class
#define BMV080_ADDR 0x57  // SparkFun BMV080 Breakout defaults to 0x57

// Initialize the display
// Make sure this matches your display type
U8G2_SSD1327_MIDAS_128X128_2_HW_I2C u8g2(U8G2_R0, /* reset=*/ U8X8_PIN_NONE);

// Store the sensor values as strings (for integers instead of floats)
char sensorValuePPM10[4] = "0";
char sensorValuePPM25[4] = "0";
char sensorValuePPM1[4] = "0";

// Threshold values for different display states
#define THRESHOLD_HIGH 30.0  // Open a Window! (high pollution)
#define THRESHOLD_MEDIUM 15.0  // Some Particles (medium pollution)
#define THRESHOLD_LOW 0.0  // Good Air! (low pollution)

// Variable to control wind icon blinking
bool showWindIcon = true;
unsigned long lastWindToggleTime = 0;
#define WIND_TOGGLE_INTERVAL 1000  // 1000ms = 1 second toggle

// Static bitmap data - keeping the variable declarations but not the actual data
static const unsigned char image_Layer_7_bits[] = {0x00,0x00,0x00,0x00,0x00,0x00,0x00,0x00,0x00,0x00,0x00,0x00,0x00,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0x00,0x00};
static const unsigned char image_Layer_8_bits[] = {0x00,0x00,0x80,0x03,0x00,0x00,0x00,0x00,0x00,0x00,0x00,0x00,0xe0,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0x00,0x00};
static const unsigned char image_Layer_9_bits[] = {0x00,0x00,0x00,0x00,0x00,0x00,0x00,0x00,0x00,0x00,0x00,0x00,0x00,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0x00,0x00};
static const unsigned char image_Particles4x4_bits[] = {0x00,0x00,0x00,0x00,0x00,0x00,0x00,0x00,0x00,0x00,0x00,0x00,0x00,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0x00,0x00};
static const unsigned char image_ParticleCube4x4empty_bits[] = {0x00,0x00,0x80,0x03,0x00,0x00,0x00,0x00,0x00,0x00,0x00,0x00,0xe0,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0x00,0x00};
static const unsigned char image_Particles4x4_1_bits[] = {0x00,0x00,0x00,0x00,0x00,0x00,0x00,0x00,0x00,0x00,0x00,0x00,0x00,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0x00,0x00};
static const unsigned char image_wind_5_512_2514588136_bits[] = {0x07,0x00,0x00,0xf0,0x0f,0x00,0x00,0x1f,0x00,0x00,0xfc,0x3f,0x00,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0x80,0x03};
static const unsigned char image_hazard_warning_bits[] = {0x00,0x00,0x00,0x00,0x00,0x00,0x00,0x00,0x00,0x00,0x00,0x00,0x00,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0x00,0x00};

void setup() {
  // Initialize USB and USB CDC
  USB.begin();
  USBSerial.begin();
  
  // Wait for USB CDC to initialize
  delay(2000);

  USBSerial.println();
  USBSerial.println("BMV080 Particle Sensor with Display");

  // Initialize I2C with slower clock speed (ONCE)
  Wire.begin();
  Wire.setClock(100000); // 100 kHz for better reliability
  
  // Initialize display (ONCE)
  bool displaySuccess = u8g2.begin();
  delay(200); // Give display time to initialize fully
  
  USBSerial.print("Display initialization: ");
  USBSerial.println(displaySuccess ? "SUCCESS" : "FAILURE");
  
  // Check if sensor is connected
  if (bmv080.begin(BMV080_ADDR, Wire) == false) {
    USBSerial.println("BMV080 not detected. Check connections. Freezing...");
    
    // Use page buffer mode here too
    u8g2.firstPage();
    do {
      u8g2.setFont(u8g2_font_profont11_tr);
      u8g2.drawStr(0, 20, "Sensor Not Found!");
    } while (u8g2.nextPage());
    
    while (1) {
      delay(1000);
      USBSerial.println("Still waiting for BMV080...");
    }
  }
  
  USBSerial.println("BMV080 found!");

  // Initialize the sensor
  USBSerial.println("Initializing BMV080...");
  bmv080.init();
  USBSerial.println("Initialization complete");

  // Set sensor to continuous mode
  if (bmv080.setMode(SF_BMV080_MODE_CONTINUOUS)) {
    USBSerial.println("BMV080 set to continuous mode");
  } else {
    USBSerial.println("Error setting BMV080 mode");
  }
  
  USBSerial.println("Setup complete");
}

// Function to display "Open a Window!" (high pollution) screen
void displayHighPollution() {
  // Check if it's time to toggle the wind icon visibility
  unsigned long currentTime = millis();
  if (currentTime - lastWindToggleTime >= WIND_TOGGLE_INTERVAL) {
    showWindIcon = !showWindIcon;  // Toggle the visibility state
    lastWindToggleTime = currentTime;
  }
  
  u8g2.firstPage();
  do {
    u8g2.setFontMode(1);
    u8g2.setBitmapMode(1);
    
    // Draw text elements
    u8g2.setFont(u8g2_font_profont11_tr);
    u8g2.drawStr(0, 8, "PPM10:");
    u8g2.drawStr(72, 30, "PPM1:");
    u8g2.drawStr(33, 19, "PPM2.5:");
    
    // Draw lines
    u8g2.drawLine(35, 9, 128, 9);
    u8g2.drawLine(74, 20, 128, 20);
    u8g2.drawLine(102, 31, 128, 31);
    
    // Draw bitmaps one at a time with small delays
    u8g2.drawXBM(-1, 28, 73, 71, image_Layer_7_bits);
    u8g2.drawXBM(0, 29, 73, 71, image_Layer_8_bits);
    u8g2.drawXBM(1, 30, 71, 69, image_Layer_9_bits);
    
    // Draw wind icon only if the toggle state is true
    if (showWindIcon) {
      u8g2.drawXBM(66, 43, 55, 51, image_wind_5_512_2514588136_bits);
    }
    
    // Draw labels and values
    u8g2.setFont(u8g2_font_profont17_tr);
    u8g2.drawStr(4, 119, "Open a Window!");
    
    u8g2.setFont(u8g2_font_profont10_tr);
    u8g2.drawStr(111, 8, sensorValuePPM10);
    u8g2.drawStr(111, 18, sensorValuePPM25);
    u8g2.drawStr(111, 29, sensorValuePPM1);
  } while (u8g2.nextPage());
  
  // No additional delay needed here as we'll use millis() for timing
}

// Function to display "Some Particles" (medium pollution) screen
void displayMediumPollution() {
  u8g2.firstPage();
  do {
    u8g2.setFontMode(1);
    u8g2.setBitmapMode(1);
    u8g2.setFont(u8g2_font_profont11_tr);
    
    u8g2.drawStr(0, 8, "PPM10:");
    u8g2.drawStr(72, 30, "PPM1:");
    u8g2.drawStr(33, 19, "PPM2.5:");
    
    u8g2.drawLine(35, 9, 128, 9);
    u8g2.drawLine(74, 20, 128, 20);
    u8g2.drawLine(102, 31, 128, 31);
    
    // Draw bitmaps for medium pollution
    u8g2.drawXBM(-1, 28, 73, 71, image_Particles4x4_bits);
    u8g2.drawXBM(1, 29, 73, 71, image_ParticleCube4x4empty_bits);
    
    u8g2.setFont(u8g2_font_profont17_tr);
    u8g2.drawStr(4, 119, "Some Particles");
    
    // Display sensor values
    u8g2.setFont(u8g2_font_profont10_tr);
    u8g2.drawStr(111, 8, sensorValuePPM10);
    u8g2.drawStr(111, 18, sensorValuePPM25);
    u8g2.drawStr(111, 29, sensorValuePPM1);
  } while (u8g2.nextPage());
}

void displayLowPollution() {
  u8g2.firstPage();
  do {
    u8g2.setFontMode(1);
    u8g2.setBitmapMode(1);
    u8g2.setFont(u8g2_font_profont11_tr);
    
    u8g2.drawStr(0, 8, "PPM10:");
    u8g2.drawStr(72, 30, "PPM1:");
    u8g2.drawStr(33, 19, "PPM2.5:");
    
    u8g2.drawLine(35, 9, 128, 9);
    u8g2.drawLine(74, 20, 128, 20);
    u8g2.drawLine(102, 31, 128, 31);
    
    // Draw bitmap for good air
    u8g2.drawXBM(1, 29, 73, 71, image_ParticleCube4x4empty_bits);
    
    u8g2.setFont(u8g2_font_profont17_tr);
    u8g2.drawStr(4, 119, "Good Air!");
    
    // Display sensor values
    u8g2.setFont(u8g2_font_profont10_tr);
    u8g2.drawStr(111, 8, sensorValuePPM10);
    u8g2.drawStr(111, 18, sensorValuePPM25);
    u8g2.drawStr(111, 29, sensorValuePPM1);
  } while (u8g2.nextPage());
}

// Function to display sensor obstructed warning
void displaySensorObstructed() {
  u8g2.firstPage();
  do {
    u8g2.setFontMode(1);
    u8g2.setBitmapMode(1);
    
    // Draw hazard warning symbol
    u8g2.drawXBM(-1, -12, 128, 128, image_hazard_warning_bits);
    
    // Draw warning text
    u8g2.setFont(u8g2_font_profont15_tr);
    u8g2.drawStr(5, 119, "Sensor Obstructed");
  } while (u8g2.nextPage());
}

void loop() {
  // Add a small delay at the start of each loop
  delay(100);
  
  // Read data from sensor
  if (bmv080.readSensor()) {
    // Get sensor readings as floats
    float pm10 = bmv080.PM10();
    float pm25 = bmv080.PM25();
    float pm1 = bmv080.PM1();
    
    // Log readings to serial monitor
    USBSerial.print("PM10: ");
    USBSerial.print(pm10);
    USBSerial.print("\t");
    USBSerial.print("PM2.5: ");
    USBSerial.print(pm25);
    USBSerial.print("\t");
    USBSerial.print("PM1: ");
    USBSerial.print(pm1);
    
    // Convert float values to integers and then to strings
    int pm10Int = (int)pm10;
    int pm25Int = (int)pm25;
    int pm1Int = (int)pm1;
    
    // Format sensor values as integer strings
    snprintf(sensorValuePPM10, 4, "%d", pm10Int);
    snprintf(sensorValuePPM25, 4, "%d", pm25Int);
    snprintf(sensorValuePPM1, 4, "%d", pm1Int);
    
    // Check if sensor is obstructed
    if (bmv080.isObstructed()) {
      USBSerial.print("\tObstructed");
      USBSerial.println();
      
      // Display the obstruction warning screen
      displaySensorObstructed();
    } else {
      USBSerial.println();
      
      // Choose display based on highest reading
      float maxReading = max(max(pm10, pm25), pm1);
      
      if (maxReading >= THRESHOLD_HIGH) {
        displayHighPollution();
      } else if (maxReading >= THRESHOLD_MEDIUM) {
        displayMediumPollution();
      } else {
        displayLowPollution();
      }
    }
  } else {
    USBSerial.println("Failed to read sensor data");
  }
  
  // Shorter delay between readings to allow for more frequent wind icon toggling
  // during high pollution state
  delay(100);
}